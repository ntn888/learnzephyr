/ {
    gpio_keys {
        compatible = "gpio-keys";
        butn: butn {
            label = "Key";
            gpios = <&gpiob 0 GPIO_ACTIVE_LOW>;
        };
    };

    aliases {
        butn0 = &butn;
    };
};

